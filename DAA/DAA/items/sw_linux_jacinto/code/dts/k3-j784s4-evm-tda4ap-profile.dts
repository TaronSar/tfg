#include "k3-j784s4-evm.dts" // Incluimos la configuración completa de la EVM

/ {
    model = "Texas Instruments J784S4 EVM (TDA4AP Profile)";
};

/* Basado en la tabla, el TDA4AP tiene 3 cores C7x y no tiene GPU */

/* Deshabilitamos el cuarto core C7x/MMA (c71_3) */
&c71_3 {
    status = "disabled";
};

/* Deshabilitamos la GPU (BXS-4-64) */
&gpu {
    status = "disabled";
};
