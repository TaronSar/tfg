## DAA/DAA/items/sw_plnx_2023/code/vbn_plnx_2023/project-spec/configs/rootfsconfigs/Kconfig.user
```kconfig
menu "user packages " 
config gpio-demo  
	 bool "gpio-demo"
	 help
	
config internet  
	 bool "internet"
	 help
	
config peekpoke  
	 bool "peekpoke"
	 help
	
config u-dma-buf  
	 bool "u-dma-buf"
	 help
	
endmenu
```

## DAA/DAA/items/sw_plnx_DPU/plnx_DPU/project-spec/configs/rootfsconfigs/Kconfig.user
```kconfig
menu "user packages " 
config dnf  
	 bool "dnf"
	 help
	
config gpio-demo  
	 bool "gpio-demo"
	 help
	
config internet  
	 bool "internet"
	 help
	
config nfs-utils  
	 bool "nfs-utils"
	 help
	
config peekpoke  
	 bool "peekpoke"
	 help
	
config python3  
	 bool "python3"
	 help
	
config python3-pip  
	 bool "python3-pip"
	 help
	
config resize-part  
	 bool "resize-part"
	 help
	
config vitis-ai-library  
	 bool "vitis-ai-library"
	 help
	
config vitis-ai-library-dbg  
	 bool "vitis-ai-library-dbg"
	 help
	
config vitis-ai-library-dev  
	 bool "vitis-ai-library-dev"
	 help
	
endmenu
```
